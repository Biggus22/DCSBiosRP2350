#ifndef __DCSBIOS_SSD1306_H
#define __DCSBIOS_SSD1306_H

#include "pico/stdlib.h"
#include "hardware/i2c.h"
#include <cstring>

static const uint8_t font5x7[] = {
    0x00,0x00,0x00,0x00,0x00,
    0x00,0x00,0x5F,0x00,0x00,
    0x00,0x07,0x00,0x07,0x00,
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    0x02,0x01,0x02,0x04,0x02,
};

class SSD1306 {
public:
    static const uint8_t WIDTH  = 128;
    static const uint8_t HEIGHT = 32;
    static const uint8_t PAGES  = HEIGHT / 8;
    static const uint16_t BUF_SIZE = WIDTH * PAGES;

    static const uint8_t FONT_W = 5;
    static const uint8_t FONT_H = 7;

    SSD1306(i2c_inst_t* i2c, uint8_t addr = 0x3C)
        : _i2c(i2c), _addr(addr) {
        memset(_buffer, 0, BUF_SIZE);
    }

    void init() {
        const uint8_t cmds[] = {
            0xAE,       // Display OFF
            0xD5, 0x80, // Set display clock divide ratio / oscillator frequency
            0xA8, HEIGHT - 1, // Set multiplex ratio (31 for 128x32)
            0xD3, 0x00, // Set display offset
            0x40,       // Set start line address
            0x8D, 0x14, // Enable charge pump regulator
            0x20, 0x00, // Set memory addressing mode (horizontal)
            0xA1,       // Set segment re-map (column 127 mapped to SEG0)
            0xC8,       // Set COM output scan direction (remapped)
            0xDA, 0x02, // Set COM pins hardware configuration
            0x81, 0x7F, // Set contrast control
            0xD9, 0xF1, // Set pre-charge period
            0xDB, 0x40, // Set VCOMH deselect level
            0xA4,       // Display all on resume
            0xA6,       // Normal display (not inverted)
            0xAF        // Display ON
        };
        for (size_t i = 0; i < sizeof(cmds); ) {
            uint8_t cmd = cmds[i++];
            writeCommand(&cmd, 1);
            if (cmd == 0xD5 || cmd == 0xA8 || cmd == 0xD3 || cmd == 0x8D ||
                cmd == 0x20 || cmd == 0xDA || cmd == 0x81 || cmd == 0xD9 || cmd == 0xDB) {
                uint8_t param = cmds[i++];
                writeCommand(&param, 1);
            }
        }
        clear();
        display();
    }

    void clear() {
        memset(_buffer, 0, BUF_SIZE);
    }

    void drawChar(int x, int y, char c, uint8_t scaleX = 1, uint8_t scaleY = 1) {
        if (x < 0 || x >= WIDTH || y < 0 || y >= HEIGHT) return;
        uint8_t idx = (c < 32 || c > 126) ? 0 : (c - 32);
        for (uint8_t col = 0; col < FONT_W; col++) {
            uint8_t data = font5x7[idx * FONT_W + col];
            for (uint8_t row = 0; row < FONT_H; row++) {
                if (data & (1 << row)) {
                    for (uint8_t sy = 0; sy < scaleY; sy++) {
                        for (uint8_t sx = 0; sx < scaleX; sx++) {
                            int px = x + (int)col * scaleX + sx;
                            int py = y + (int)row * scaleY + sy;
                            if (px >= 0 && px < WIDTH && py >= 0 && py < HEIGHT) {
                                setPixel(px, py);
                            }
                        }
                    }
                }
            }
        }
    }

    void drawString(int x, int y, const char* str, uint8_t scaleX = 1, uint8_t scaleY = 1) {
        int cx = x;
        while (*str) {
            drawChar(cx, y, *str, scaleX, scaleY);
            cx += (FONT_W + 1) * scaleX;
            str++;
        }
    }

    void display() {
        uint8_t colStart = 0;
        uint8_t colEnd = WIDTH - 1;
        uint8_t setColCmd[] = {
            0x21,
            colStart,
            colEnd
        };
        writeCommand(setColCmd, 3);

        uint8_t setRowCmd[] = {
            0x22,
            0x00,
            PAGES - 1
        };
        writeCommand(setRowCmd, 3);

        for (uint8_t page = 0; page < PAGES; page++) {
            uint8_t pageCmd[] = {
                (uint8_t)(0xB0 | page),
                (uint8_t)(0x00 | (colStart & 0x0F)),
                (uint8_t)(0x10 | (colStart >> 4))
            };
            writeCommand(pageCmd, 3);
            writeData(&_buffer[page * WIDTH], WIDTH);
        }
    }

    void setPixel(int x, int y) {
        if (x < 0 || x >= WIDTH || y < 0 || y >= HEIGHT) return;
        uint8_t page = y / 8;
        uint8_t bit  = y % 8;
        _buffer[page * WIDTH + x] |= (1 << bit);
    }

private:
    i2c_inst_t* _i2c;
    uint8_t _addr;
    uint8_t _buffer[BUF_SIZE];

    void writeCommand(const uint8_t* data, size_t len) {
        uint8_t buf[17];
        buf[0] = 0x00;
        size_t chunk = (len > 16) ? 16 : len;
        memcpy(buf + 1, data, chunk);
        i2c_write_blocking(_i2c, _addr, buf, chunk + 1, false);
        if (len > chunk) {
            writeCommand(data + chunk, len - chunk);
        }
    }

    void writeData(const uint8_t* data, size_t len) {
        uint8_t buf[17];
        buf[0] = 0x40;
        while (len > 0) {
            size_t chunk = (len > 16) ? 16 : len;
            memcpy(buf + 1, data, chunk);
            i2c_write_blocking(_i2c, _addr, buf, chunk + 1, false);
            data += chunk;
            len -= chunk;
        }
    }
};

#endif
